## boards/arm/eknrf/Kconfig
```kconfig
config BOARD_EKGO_CHARGER
    bool "Enable battery charger"
    default y
    depends on (BOARD_EKGO && BOARD_REVISION = "1.0.0")

config BOARD_EKNRF
    bool "eknrf"
    depends on SOC_NRF52840_QIAA
    select SOC_SERIES_NRF52X # This enables HAS_NRFX and basic peripherals
    select CLOCK_CONTROL      # This fixes the CLOCK_CONTROL_NRF warning s
```

## boards/arm/eknrf/Kconfig.board
```kconfig
config BOARD_EKNRF
    bool "eknrf"
    depends on SOC_NRF52840_QIAA        
    select SOC_SERIES_NRF52X # This enables HAS_NRFX and basic peripherals
    select CLOCK_CONTROL      # This fixes the CLOCK_CONTROL_NRF warning
    imply RETAINED_MEM
    imply RETENTION
    imply RETENTION_BOOT_MODE
```

## boards/arm/eknrf/Kconfig.defconfig
```kconfig
# Electronut Labs Papyr board configuration

# Copyright (c) 2020 The ZMK Contributors
# SPDX-License-Identifier: MIT

if BOARD_EKNRF

config BOARD
    default "eknrf"

config BT_CTLR
    default BT

config CONFIG_MPU_ALLOW_FLASH_WRITE
    default y

if USB

config USB_NRFX
    default y

config USB_DEVICE_STACK
    default y

endif # USB

endif 
```

## boards/arm/eknrf/Kconfig.eknrf
```kconfig
# eknrf board configuration

# Copyright (c) 2020 The ZMK Contributors
# SPDX-License-Identifier: MIT

config BOARD_EKNRF
    select SOC_NRF52840_QIAA if BOARD_EKNRF_NRF52840
    imply RETAINED_MEM
    imply RETENTION
    imply RETENTION_BOOT_MODE
```

## boards/shields/ekgo/Kconfig.defconfig
```kconfig
if SHIELD_EKGO_LEFT

config ZMK_KEYBOARD_NAME
    default "Ekgo"

config ZMK_SPLIT_ROLE_CENTRAL
    default y

endif

if SHIELD_EKGO_LEFT || SHIELD_EKGO_RIGHT

config ZMK_SLEEP
    default y

config ZMK_SPLIT
    default y

config BT_CTLR
    default BT

config ZMK_BATTERY_REPORTING
    default y

config ZMK_EXT_POWER
    default y

config ZMK_DISPLAY
    default y

endif
```

## boards/shields/ekgo/Kconfig.shield
```kconfig
config SHIELD_EKGO_LEFT
    def_bool $(shields_list_contains,ekgo_left)
    
config SHIELD_EKGO_RIGHT
    def_bool $(shields_list_contains,ekgo_right)
```
